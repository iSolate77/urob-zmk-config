#include <behaviors.dtsi>
#include <behaviors/num_word.dtsi> // Requires auto-layer module.
#include <dt-bindings/zmk/keys.h>
#ifdef CONFIG_WIRELESS
#include <dt-bindings/zmk/bt.h>
#include <dt-bindings/zmk/outputs.h>
#define _BT_SEL_KEYS_                                                          \
  &bt BT_SEL 0 &bt BT_SEL 1 &bt BT_SEL 2 &bt BT_SEL 3 &bt BT_CLR
#else
#define _BT_SEL_KEYS_ &trans & trans & trans & trans &trans
#endif

#include "zmk-helpers/helper.h"

#define DEF 0
#define NAV 1
#define FN 2
#define NUM 3
#define SYS 4
#define MOUSE 5

#define XXX &none
#define ___ &trans
#define MEH LC(LS(LALT))

/* Global defaults */

#define QUICK_TAP_MS 100

&sk {
  release-after-ms = <900>;
  quick-release;
};

&sl { // Allow sticky mods to chord across sticky layers.
  ignore-modifiers;
};

&lt {
  flavor = "tap-preferred";
  tapping-term-ms = <145>;
  quick-tap-ms = <QUICK_TAP_MS>;
};

&soft_off {
    hold-time-ms = <2000>;
};


/ {
    wakeup_scan: wakeup_scan {
        compatible = "zmk,kscan-gpio-direct";
        input-gpios = <&pro_micro 7 (GPIO_ACTIVE_LOW | GPIO_PULL_UP)>, <&pro_micro 21 (GPIO_ACTIVE_LOW | GPIO_PULL_UP)>;
        wakeup-source;
    };
};

/ {
    side_band_behavior_triggers: side_band_behavior_triggers {
        compatible = "zmk,kscan-sideband-behaviors";
        kscan = <&wakeup_scan>;
        auto-enable;
        wakeup-source;
    };
};

/ {
    soft_off_wakers {
        compatible = "zmk,soft-off-wakeup-sources";
        wakeup-sources = <&wakeup_scan>;
    };
};

/* Homerow mods */

#define KEYS_L LT0 LT1 LT2 LT3 LT4 LM0 LM1 LM2 LM3 LM4 LB0 LB1 LB2 LB3 LB4
#define KEYS_R RT0 RT1 RT2 RT3 RT4 RM0 RM1 RM2 RM3 RM4 RB0 RB1 RB2 RB3 RB4
#ifndef LH2
#define THUMBS LH1 LH0 RH0 RH1 // Thumbs on 34 keys.
#else
#define THUMBS LH2 LH1 LH0 RH0 RH1 RH2 // Thumbs on 36+ keys.
#endif

#define MAKE_HRM(NAME, HOLD, TAP, TRIGGER_POS)                                 \
  ZMK_HOLD_TAP(NAME, bindings = <HOLD>, <TAP>; flavor = "balanced";            \
               tapping-term-ms = <200>; quick-tap-ms = <QUICK_TAP_MS>; \
               require-prior-idle-ms = <100>;                            \
               hold-trigger-on-release;                                  \
               hold-trigger-key-positions = <TRIGGER_POS>;)

MAKE_HRM(hml, &kp, &kp, KEYS_R THUMBS) // Left-hand HRMs.
MAKE_HRM(hmr, &kp, &kp, KEYS_L THUMBS) // Right-hand HRMs.

// Hack: Make HRM combos tap-only (cf, ZMK issue #544).
#define ZMK_COMBO_8(NAME, TAP, POS, LAYERS, COMBO_MS, IDLE_MS, HOLD, SIDE)     \
  MAKE_HRM(hm_combo_##NAME, &kp, TAP, SIDE THUMBS)                             \
  ZMK_COMBO_6(NAME, &hm_combo_##NAME HOLD 0, POS, LAYERS, COMBO_MS, IDLE_MS)

/* Combos, leader key sequences, mouse emulation */

#include "combos.dtsi" // Must be sourced after HRM-combo hack.
#include "mouse.dtsi"

/* Nav cluster */

// Trigger tap-action on all interrupts.
#define MT_CORE                                                                \
  flavor = "tap-preferred";                                                    \
  tapping-term-ms = <220>;                                                 \
  quick-tap-ms = <220>;                                                    \
  hold-trigger-key-positions = <0>;                \
  hold-while-undecided-linger;

&mt{MT_CORE};

ZMK_HOLD_TAP(mt_home, bindings = <&masked_home>, <&kp>; MT_CORE)
ZMK_HOLD_TAP(mt_end, bindings = <&masked_end>, <&kp>; MT_CORE)

#define NAV_LEFT &mt_home 0 LEFT   // Tap: left  | Long-tap: start of line.
#define NAV_RIGHT &mt_end 0 RIGHT  // Tap: right | Long-tap: end   of line.
#define NAV_UP &mt LC(HOME) UP     // Tap: up    | Long-tap: start of doc.
#define NAV_DOWN &mt LC(END) DOWN  // Tap: down  | Long-tap: end   of doc.
#define NAV_BSPC &mt LC(BSPC) BSPC // Tap: bspc  | Long-tap: delete word bwd.
#define NAV_DEL &mt LC(DEL) DEL    // Tap: del   | Long-tap: delete word fwd.

// Mask CTRL on left/right hold to avoid accidental jumps to start/end of doc.
#define MASK_MODS(NAME, MODS, BINDING)                                         \
  ZMK_MOD_MORPH(NAME, bindings = <BINDING>, <BINDING>; mods = <MODS>;)

MASK_MODS(masked_home, (MOD_LCTL), &kp HOME)
MASK_MODS(masked_end, (MOD_LCTL), &kp END)

/* Magic-shift & auto-layers */

// Tap: repeat after alpha, else sticky-shift |
// Shift + tap/ double-tap: caps-word | Hold: shift.
#define MAGIC_SHIFT &magic_shift LSHFT 0
ZMK_HOLD_TAP(magic_shift, bindings = <&kp>, <&magic_shift_tap>;
             flavor = "tap-preferred"; tapping-term-ms = <140>;
             quick-tap-ms = <QUICK_TAP_MS>; require-prior-idle-ms = <60>;)
ZMK_MOD_MORPH(magic_shift_tap, bindings = <&shift_repeat>, <&caps_word>;
              mods = <(MOD_LSFT)>;)
ZMK_ADAPTIVE_KEY(
    shift_repeat, bindings = <&sk LSHFT>; repeat {
      trigger-keys = <A B C D E F G H I J K L M N O P Q R S T U V W X Y Z>;
      bindings = <&key_repeat>;
      max-prior-idle-ms = <350>;
      strict-modifiers;
    };)

/ {
    macros {
        // Optimized macros with pause_for_release to prevent interruption
        ation_macro: ation_macro {
            compatible = "zmk,behavior-macro";
            #binding-cells = <0>;
            wait-ms = <0>;
            tap-ms = <1>;
            bindings = <&macro_pause_for_release>, <&macro_tap &kp T &kp I &kp O &kp N>;
        };
        
        before_macro: before_macro {
            compatible = "zmk,behavior-macro";
            #binding-cells = <0>;
            wait-ms = <0>; 
            tap-ms = <1>;
            bindings = <&macro_pause_for_release>, <&macro_tap &kp E &kp F &kp O &kp R &kp E>;
        };
        
        ction_macro: ction_macro {
            compatible = "zmk,behavior-macro";
            #binding-cells = <0>;
            wait-ms = <0>;
            tap-ms = <1>;
            bindings = <&macro_pause_for_release>, <&macro_tap &kp T &kp I &kp O &kp N>;
        };
        
        dition_macro: dition_macro {
            compatible = "zmk,behavior-macro";
            #binding-cells = <0>;
            wait-ms = <0>;
            tap-ms = <1>;
            bindings = <&macro_pause_for_release>, <&macro_tap &kp I &kp T &kp I &kp O &kp N>;
        };
        
        fy_macro: fy_macro {
            compatible = "zmk,behavior-macro";
            #binding-cells = <0>;
            wait-ms = <0>;
            tap-ms = <1>;
            bindings = <&macro_pause_for_release>, <&macro_tap &kp Y>;
        };
        
        gs_macro: gs_macro {
            compatible = "zmk,behavior-macro";
            #binding-cells = <0>;
            wait-ms = <0>;
            tap-ms = <1>;
            bindings = <&macro_pause_for_release>, <&macro_tap &kp S>;
        };
        
        hy_macro: hy_macro {
            compatible = "zmk,behavior-macro";
            #binding-cells = <0>;
            wait-ms = <0>;
            tap-ms = <1>;
            bindings = <&macro_pause_for_release>, <&macro_tap &kp Y>;
        };

        ing_macro: ing_macro {
            compatible = "zmk,behavior-macro";
            #binding-cells = <0>;
            wait-ms = <0>;
            tap-ms = <1>;
            bindings = <&macro_pause_for_release>, <&macro_tap &kp N &kp G>;
        };
        
        just_macro: just_macro {
            compatible = "zmk,behavior-macro";
            #binding-cells = <0>;
            wait-ms = <0>;
            tap-ms = <1>;
            bindings = <&macro_pause_for_release>, <&macro_tap &kp U &kp S &kp T>;
        };
        
        lation_macro: lation_macro {
            compatible = "zmk,behavior-macro";
            #binding-cells = <0>;
            wait-ms = <0>;
            tap-ms = <1>;
            bindings = <&macro_pause_for_release>, <&macro_tap &kp A &kp T &kp I &kp O &kp N>;
        };
        
        ment_macro: ment_macro {
            compatible = "zmk,behavior-macro";
            #binding-cells = <0>;
            wait-ms = <0>;
            tap-ms = <1>;
            bindings = <&macro_pause_for_release>, <&macro_tap &kp E &kp N &kp T>;
        };
        
        nion_macro: nion_macro {
            compatible = "zmk,behavior-macro";
            #binding-cells = <0>;
            wait-ms = <0>;
            tap-ms = <1>;
            bindings = <&macro_pause_for_release>, <&macro_tap &kp I &kp O &kp N>;
        };
        
        oa_macro: oa_macro {
            compatible = "zmk,behavior-macro";
            #binding-cells = <0>;
            wait-ms = <0>;
            tap-ms = <1>;
            bindings = <&macro_pause_for_release>, <&macro_tap &kp A>;
        };
        
        ph_macro: ph_macro {
            compatible = "zmk,behavior-macro";
            #binding-cells = <0>;
            wait-ms = <0>;
            tap-ms = <1>;
            bindings = <&macro_pause_for_release>, <&macro_tap &kp H>;
        };
        
        quen_macro: quen_macro {
            compatible = "zmk,behavior-macro";
            #binding-cells = <0>;
            wait-ms = <0>;
            tap-ms = <1>;
            bindings = <&macro_pause_for_release>, <&macro_tap &kp U &kp E &kp N>;
        };
        
        rl_macro: rl_macro {
            compatible = "zmk,behavior-macro";
            #binding-cells = <0>;
            wait-ms = <0>;
            tap-ms = <1>;
            bindings = <&macro_pause_for_release>, <&macro_tap &kp L>;
        };
        
        sc_macro: sc_macro {
            compatible = "zmk,behavior-macro";
            #binding-cells = <0>;
            wait-ms = <0>;
            tap-ms = <1>;
            bindings = <&macro_pause_for_release>, <&macro_tap &kp C>;
        };
        
        tment_macro: tment_macro {
            compatible = "zmk,behavior-macro";
            #binding-cells = <0>;
            wait-ms = <0>;
            tap-ms = <1>;
            bindings = <&macro_pause_for_release>, <&macro_tap &kp M &kp E &kp N &kp T>;
        };
        
        ue_macro: ue_macro {
            compatible = "zmk,behavior-macro";
            #binding-cells = <0>;
            wait-ms = <0>;
            tap-ms = <1>;
            bindings = <&macro_pause_for_release>, <&macro_tap &kp E>;
        };
        
        ver_macro: ver_macro {
            compatible = "zmk,behavior-macro";
            #binding-cells = <0>;
            wait-ms = <0>;
            tap-ms = <1>;
            bindings = <&macro_pause_for_release>, <&macro_tap &kp E &kp R>;
        };
        
        ws_macro: ws_macro {
            compatible = "zmk,behavior-macro";
            #binding-cells = <0>;
            wait-ms = <0>;
            tap-ms = <1>;
            bindings = <&macro_pause_for_release>, <&macro_tap &kp S>;
        };
        
        y_apos_macro: y_apos_macro {
            compatible = "zmk,behavior-macro";
            #binding-cells = <0>;
            wait-ms = <0>;
            tap-ms = <1>;
            bindings = <&macro_pause_for_release>, <&macro_tap &kp APOS>;
        };
        
        zation_macro: zation_macro {
            compatible = "zmk,behavior-macro";
            #binding-cells = <0>;
            wait-ms = <0>;
            tap-ms = <1>;
            bindings = <&macro_pause_for_release>, <&macro_tap &kp A &kp T &kp I &kp O &kp N>;
        };
        
        the_macro: the_macro {
            compatible = "zmk,behavior-macro";
            #binding-cells = <0>;
            wait-ms = <0>;
            tap-ms = <1>;
            bindings = <&macro_pause_for_release>, <&macro_tap &kp T &kp H &kp E>;
        };
    };
};

// Optimized tap-dance and smart-num for faster magic key access
#define SMART_NUM &smart_num NUM 0
ZMK_HOLD_TAP(smart_num, bindings = <&mo>, <&num_dance>; 
             flavor = "tap-preferred";  // Optimized for faster tap detection
             tapping-term-ms = <160>;   // Reduced from 200ms
             quick-tap-ms = <QUICK_TAP_MS>;)
ZMK_TAP_DANCE(num_dance, bindings = <&magic_key>, <&num_word NUM>;
              tapping-term-ms = <120>;)  // Reduced from 200ms for faster recognition

// Complete magic key implementation with all triggers and optimized timing
ZMK_ADAPTIVE_KEY(
    magic_key, bindings = <&sl NUM>; 
    a_trigger {  
        trigger-keys = <A>;
        bindings = <&ation_macro>;
        max-prior-idle-ms = <600>;  // Optimized from 600ms
    };
    b_trigger {  
        trigger-keys = <B>;
        bindings = <&before_macro>;
        max-prior-idle-ms = <600>;
    };
    c_trigger {  
        trigger-keys = <C>;
        bindings = <&ction_macro>;
        max-prior-idle-ms = <600>;
    };
    d_trigger {  
        trigger-keys = <D>;
        bindings = <&dition_macro>;
        max-prior-idle-ms = <600>;
    };
    e_trigger {  
        trigger-keys = <E>;
        bindings = <&kp U>;  // Direct for 2-char
        max-prior-idle-ms = <600>;
    };
    f_trigger {  
        trigger-keys = <F>;
        bindings = <&fy_macro>;
        max-prior-idle-ms = <600>;
    };
    g_trigger {  
        trigger-keys = <G>;
        bindings = <&gs_macro>;
        max-prior-idle-ms = <600>;
    };
    h_trigger {  
        trigger-keys = <H>;
        bindings = <&hy_macro>;
        max-prior-idle-ms = <600>;
    };
    i_trigger {
        trigger-keys = <I>;
        bindings = <&ing_macro>;
        max-prior-idle-ms = <600>;
    };
    j_trigger {  
        trigger-keys = <J>;
        bindings = <&just_macro>;
        max-prior-idle-ms = <600>;
    };
    l_trigger {  
        trigger-keys = <L>;
        bindings = <&lation_macro>;
        max-prior-idle-ms = <600>;
    };
    m_trigger {  
        trigger-keys = <M>;
        bindings = <&ment_macro>;
        max-prior-idle-ms = <600>;
    };
    n_trigger {  
        trigger-keys = <N>;
        bindings = <&nion_macro>;
        max-prior-idle-ms = <600>;
    };
    o_trigger {  
        trigger-keys = <O>;
        bindings = <&oa_macro>;
        max-prior-idle-ms = <600>;
    };
    p_trigger {  
        trigger-keys = <P>;
        bindings = <&ph_macro>;
        max-prior-idle-ms = <600>;
    };
    q_trigger {  
        trigger-keys = <Q>;
        bindings = <&quen_macro>;
        max-prior-idle-ms = <600>;
    };
    r_trigger {  
        trigger-keys = <R>;
        bindings = <&rl_macro>;
        max-prior-idle-ms = <600>;
    };
    s_trigger {  
        trigger-keys = <S>;
        bindings = <&sc_macro>;
        max-prior-idle-ms = <600>;
    };
    t_trigger {  
        trigger-keys = <T>;
        bindings = <&tment_macro>;
        max-prior-idle-ms = <600>;
    };
    u_trigger {  
        trigger-keys = <U>;
        bindings = <&ue_macro>;
        max-prior-idle-ms = <600>;
    };
    v_trigger {  
        trigger-keys = <V>;
        bindings = <&ver_macro>;
        max-prior-idle-ms = <600>;
    };
    w_trigger {  
        trigger-keys = <W>;
        bindings = <&ws_macro>;
        max-prior-idle-ms = <600>;
    };
    y_trigger {  
        trigger-keys = <Y>;
        bindings = <&y_apos_macro>;
        max-prior-idle-ms = <600>;
    };
    z_trigger {  
        trigger-keys = <Z>;
        bindings = <&zation_macro>;
        max-prior-idle-ms = <600>;
    };
    space_trigger {  
        trigger-keys = <SPACE>;
        bindings = <&the_macro>;
        max-prior-idle-ms = <600>;
    };)

// Smart-mouse, requires tri-state module.
ZMK_TRI_STATE(
    smart_mouse, bindings = <&tog MOUSE>, <&none>, <&tog MOUSE>;
    ignored-key-positions =
        <LT1 LT2 LH0 LH1 RT1 RT2 RT3 RM0 RM1 RM2 RM3 RM4 RB1 RB2 RB3 RH0 RH1>;
    ignored-layers = <MOUSE NAV FN>;)

// Alt+Tab swapper, requires tri-state module.
ZMK_TRI_STATE(swapper, bindings = <&kt LGUI>, <&kp TAB>, <&kt LGUI>;
              ignored-key-positions = <LT2>;)

// Define mod-morph with a *single* mod trigger for less repetition.
#define SIMPLE_MORPH(NAME, MOD, BINDING1, BINDING2)                            \
  ZMK_MOD_MORPH(NAME, mods = <(MOD_L##MOD | MOD_R##MOD)>;                      \
                bindings = <BINDING1>, <BINDING2>;)

// Tap: comma | Shift + tap: semicolon | Ctrl + shift + tap: <.
SIMPLE_MORPH(comma_morph, SFT, &kp COMMA, &comma_inner_morph)
SIMPLE_MORPH(comma_inner_morph, CTL, &kp SEMICOLON, &kp LESS_THAN)

// Tap: dot | Shift + tap: colon | Ctrl + shift + tap: >.
SIMPLE_MORPH(dot_morph, SFT, &kp DOT, &dot_inner_morph)
SIMPLE_MORPH(dot_inner_morph, CTL, &kp COLON, &kp GREATER_THAN)

// Tap: qmark | Shift + tap: excl.
SIMPLE_MORPH(qexcl, SFT, &kp QMARK, &kp EXCL)

// Tap: left/right parenthesis | Shft + tap: less-than/greater-than.
SIMPLE_MORPH(lpar_lt, SFT, &kp LPAR, &kp LT)
SIMPLE_MORPH(rpar_gt, SFT, &kp RPAR, &kp GT)

// Tap: space | Hold: nav layer.
ZMK_HOLD_TAP(lt_spc, bindings = <&mo>, <&kp>; flavor = "balanced";
             tapping-term-ms = <200>; quick-tap-ms = <QUICK_TAP_MS>;)

// Tap: backspace | Lshft + tap: delete | Rshft + tap: shift-delete.
ZMK_MOD_MORPH(bs_del, bindings = <&kp BSPC>, <&kp DEL>;
              mods = <(MOD_LSFT | MOD_RSFT)>; keep-mods = <MOD_RSFT>;)

// Tap: copy | double-tap: cut.
ZMK_TAP_DANCE(copy_cut, bindings = <&kp LC(INS)>, <&kp LC(X)>;
              tapping-term-ms = <200>;)

/* Keymap */

ZMK_CONDITIONAL_LAYER(sys, FN NUM, SYS) // FN + NUM --> SYS.

#ifndef ZMK_BASE_LAYER
  #define ZMK_BASE_LAYER(name, LT, RT, LM, RM, LB, RB, LH, RH) \
      ZMK_LAYER(name, LT RT LM RM LB RB LH RH)
#endif

ZMK_BASE_LAYER(Base,
//╭─────────────┬─────────────┬─────────────┬─────────────┬─────────────╮ ╭─────────────┬─────────────┬─────────────┬─────────────┬─────────────╮
    &kp B         &kp L         &kp D         &kp W         &kp Z       ,   &kp SQT       &kp F         &kp O         &kp U         &kp J       ,
//├─────────────┼─────────────┼─────────────┼─────────────┼─────────────┤ ├─────────────┼─────────────┼─────────────┼─────────────┼─────────────┤
    &hml LSHFT N  &hml LCTRL R  &hml LALT T   &hml LGUI S   &hml MEH G  ,   &hmr MEH Y    &hmr RGUI H   &hmr RALT A   &hmr LCTRL E  &hmr RSHFT I,
//├─────────────┼─────────────┼─────────────┼─────────────┼─────────────┤ ├─────────────┼─────────────┼─────────────┼─────────────┼─────────────┤
    &kp Q         &kp X         &kp M         &kp C         &kp V       ,   &kp K         &kp P         &comma_morph  &dot_morph    &qexcl      ,
//╰─────────────┼─────────────┴─────────────┼─────────────┼─────────────┤ ├─────────────┼─────────────┼─────────────┴───────────────────────────╯
                                              &lt_spc NAV SPC &lt FN RET  , SMART_NUM     MAGIC_SHIFT                                            
//                                          ╰─────────────┴─────────────╯ ╰─────────────┴─────────────╯                                         
)

ZMK_BASE_LAYER(Nav,
//╭─────────────┬─────────────┬─────────────┬─────────────┬─────────────╮ ╭─────────────┬─────────────┬─────────────┬─────────────┬─────────────╮
    ___           ___           &kp LS(TAB)   &swapper      ___         ,   &kp PG_UP     NAV_BSPC      NAV_UP        NAV_DEL       ___         ,
//├─────────────┼─────────────┼─────────────┼─────────────┼─────────────┤ ├─────────────┼─────────────┼─────────────┼─────────────┼─────────────┤
    &sk LSHFT     &sk LCTRL     &sk LALT      &sk LGUI     &sk MEH      ,  &kp PG_DN     NAV_LEFT      NAV_DOWN      NAV_RIGHT     &kp RET      ,
//├─────────────┼─────────────┼─────────────┼─────────────┼─────────────┤ ├─────────────┼─────────────┼─────────────┼─────────────┼─────────────┤
    ___           ___           ___           ___           ___         ,   &kp INS       &kp TAB       &kp LT        &kp GT        ___         ,
//╰─────────────┼─────────────┴─────────────┼─────────────┼─────────────┤ ├─────────────┼─────────────┼─────────────┴───────────────────────────╯
                                              ___           ___         ,   ___           ___                                                 
//                                          ╰─────────────┴─────────────╯ ╰─────────────┴─────────────╯                                         
)

ZMK_BASE_LAYER(Fn,
//╭─────────────┬─────────────┬─────────────┬─────────────┬─────────────╮ ╭─────────────┬─────────────┬─────────────┬─────────────┬─────────────╮
    &kp F12       &kp F7        &kp F8        &kp F9        ___         ,   ___           &kp C_PREV    &kp C_VOL_UP  &kp C_NEXT    ___         ,
//├─────────────┼─────────────┼─────────────┼─────────────┼─────────────┤ ├─────────────┼─────────────┼─────────────┼─────────────┼─────────────┤
    &hml LSHFT F11 &hml LCTRL F4  &hml LALT F5 &hml LGUI F6 ___         ,   ___           ___           &kp C_VOL_DN  ___           ___         ,
//├─────────────┼─────────────┼─────────────┼─────────────┼─────────────┤ ├─────────────┼─────────────┼─────────────┼─────────────┼─────────────┤
    &kp F10       &kp F1        &kp F2        &kp F3        ___         ,   ___           &kp C_BRI_DN  ___           &kp C_BRI_UP  ___         ,
//╰─────────────┼─────────────┴─────────────┼─────────────┼─────────────┤ ├─────────────┼─────────────┼─────────────┴───────────────────────────╯
                                              ___           ___         ,   &kp K_MUTE    &kp C_PP                                               
//                                          ╰─────────────┴─────────────╯ ╰─────────────┴─────────────╯                                         
)

ZMK_BASE_LAYER(Num,
//╭─────────────┬─────────────┬─────────────┬─────────────┬─────────────╮ ╭─────────────┬─────────────┬─────────────┬─────────────┬─────────────╮
    ___           &kp N7        &kp N8        &kp N9        ___         ,   ___           ___           ___           ___           ___         ,
//├─────────────┼─────────────┼─────────────┼─────────────┼─────────────┤ ├─────────────┼─────────────┼─────────────┼─────────────┼─────────────┤
    ___           &hml LCTRL N4 &hml LALT N5  &hml LGUI N6  &hml MEH N0 ,   ___           ___           ___           ___           ___         ,
//├─────────────┼─────────────┼─────────────┼─────────────┼─────────────┤ ├─────────────┼─────────────┼─────────────┼─────────────┼─────────────┤
    ___           &kp N1        &kp N2        &kp N3        ___         ,   ___           ___           ___           ___           ___         ,
//╰─────────────┼─────────────┴─────────────┼─────────────┼─────────────┤ ├─────────────┼─────────────┼─────────────┴───────────────────────────╯
                                              ___           ___         ,   ___           ___                                                    
//                                          ╰─────────────┴─────────────╯ ╰─────────────┴─────────────╯                                         
)

ZMK_BASE_LAYER(Sys,
//╭─────────────┬─────────────┬─────────────┬─────────────┬─────────────╮ ╭─────────────┬─────────────┬─────────────┬─────────────┬─────────────╮
                               _BT_SEL_KEYS_                            ,   ___           ___           ___           ___           ___         ,
//├─────────────┼─────────────┼─────────────┼─────────────┼─────────────┤ ├─────────────┼─────────────┼─────────────┼─────────────┼─────────────┤
    ___           ___           ___           ___           &bootloader ,   &bootloader   ___           ___           ___           ___         ,
//├─────────────┼─────────────┼─────────────┼─────────────┼─────────────┤ ├─────────────┼─────────────┼─────────────┼─────────────┼─────────────┤
    ___           ___           ___           ___           &sys_reset  ,   &sys_reset    ___           ___           ___           ___         ,
//╰─────────────┼─────────────┴─────────────┼─────────────┼─────────────┤ ├─────────────┼─────────────┼─────────────┴───────────────────────────╯
                                              ___           ___         ,   ___           ___                                                    
//                                          ╰─────────────┴─────────────╯ ╰─────────────┴─────────────╯                                         
)

ZMK_BASE_LAYER(Mouse,
//╭─────────────┬─────────────┬─────────────┬─────────────┬─────────────╮ ╭─────────────┬─────────────┬─────────────┬─────────────┬─────────────╮
     ___           ___           ___           ___           ___        ,    ___           &kp PG_UP     U_MS_U         &kp PG_DN    ___        , 
//├─────────────┼─────────────┼─────────────┼─────────────┼─────────────┤ ├─────────────┼─────────────┼─────────────┼─────────────┼─────────────┤
     ___           ___           ___           ___           ___        ,    U_WH_L        U_MS_L        U_MS_D         U_MS_R       U_WH_R     , 
//├─────────────┼─────────────┼─────────────┼─────────────┼─────────────┤ ├─────────────┼─────────────┼─────────────┼─────────────┼─────────────┤
     ___           ___           ___           ___           ___        ,    ___           &mkp LCLK     &mkp MCLK      &mkp RCLK    ___        , 
//╰─────────────┼─────────────┴─────────────┼─────────────┼─────────────┤ ├─────────────┼─────────────┼─────────────┴───────────────────────────╯
                                               ___           ___        ,    U_WH_U        U_WH_D
//                                          ╰─────────────┴─────────────╯ ╰─────────────┴─────────────╯                                         
)


/* vim: set ft=c tw=174: */
